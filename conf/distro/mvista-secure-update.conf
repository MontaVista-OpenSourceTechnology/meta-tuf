## conf/distro/mvista-secure-update.conf
```bitbake
require conf/distro/mvista-cgx.conf

DISTROOVERRIDES .= ":mvista-cgx"

DISTRO_NAME = "mvista-secure-update"
DISTRO_VERSION = "1.0"

DISTRO_FEATURES:remove = "alsa bluetooth usbgadget nfc x11 pulseaudio \
		          ptest pcmcia nfs systemd-resolved opengl"
```
